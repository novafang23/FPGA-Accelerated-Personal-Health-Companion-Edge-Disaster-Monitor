## firmware/shrikefi/main/Kconfig.projbuild
```kconfig
menu "ShrikeFi configuration"

    # NOTE: there is deliberately NO option to disable embedding the ForgeFPGA
    # bitstream. Programming the FPGA over SPI2 at boot is what makes the SPI
    # runtime link work, and the 46,408-byte image costs 0.6% of the 7 MB app
    # partition (about 87% free). An earlier revision made this conditional; because
    # sdkconfig is gitignored and keeps its own value, that silently turned the
    # FPGA path off on any checkout whose sdkconfig predated the option - so it
    # was removed rather than left as a footgun.

    config SHRIKEFI_SOFTAP
        bool "Serve the local status page over a self-hosted access point"
        default y
        help
            Raises an open access point named VALOR-xxxx (the last two MAC
            bytes) and serves a live status page on http://192.168.4.1. Any
            phone can join it and read the patient's vitals, the triage verdict
            and the active risk level. No router, no credentials and no
            association step - which is what requirement 5's "operate
            effectively with intermittent or no internet" actually asks for,
            and what makes requirement 6 reachable by a rescuer who has no
            laptop and no cable.

            The access point is deliberately OPEN. It is an emergency status
            page, and a passphrase would be a credential a bystander does not
            have. Anyone in WiFi range can read the live vitals and location.
            Cloud publishing stays off unless SHRIKEFI_DEV_MQTT is enabled.

            THIS REPLACES THE WIFI STATION PATH. With this on, wifi_mqtt_init()
            is not called and the radio is used only for the access point. Two
            reasons: cloud publishing is off by default, so the station
            connection had no function beyond its own failure modes; and an
            AP+STA radio forces the access point onto whatever channel the
            station associates on, which would drop a connected phone
            mid-demonstration. Turn this off to get the station path back.

    config SHRIKEFI_DEV_MQTT
        bool "Enable MQTT cloud publishing (DEV ONLY)"
        default n
        help
            Enables publishing of health data (HR, SpO2, RMSSD, triage status, etc.)
            to an MQTT broker. This is OFF by default to ensure patient data privacy
            (Issue S-01).

            When enabled, the device will connect to the broker specified in
            wifi_mqtt_manager.c and broadcast telemetry. Use with caution.
            WARNING: DEV ONLY.

    config SHRIKEFI_STREAM_PPG
        bool "Stream per-sample PPG and FPGA link debug over the console"
        default y
        help
            Prints two high-rate diagnostic streams:

              [PPG] <raw IR>            one line per optical sample, 50 Hz
              FG <n> <tx> <rx> <beat>   periodic FPGA link-debug line

            ON by default because the web dashboard's oscilloscope is driven by
            the [PPG] stream - with this OFF, live mode still shows every number
            but the waveform stays flat.

            Turn it OFF when you need a readable log. Those two lines are roughly
            90% of console output and they bury the lines that actually answer
            questions at bring-up:

              ForgeFPGA runtime link handshake: probe sent 0x55, received 0x..
              IBI detector handover -> ForgeFPGA / software fallback
              [TRIAGE] NEWS2=..,RISK=..

            [TELEMETRY] and [TRIAGE] are NOT affected: the dashboard keeps every
            reading, and only the waveform is lost.

            This is the low-rate FG mode (every 25th transaction). The full-rate
            dump that tools/replay_fpga_link_log.py consumes is a separate macro,
            SHRIKEFI_LINK_FULL_RATE_LOG in shrikefi_link_driver.c, which is off
            unless edited - that one really is unreadable while it runs.


    config SHRIKEFI_WIFI_SSID
        string "WiFi SSID (2.4 GHz only; leave empty for offline edge mode)"
        default ""
        help
            Network name for the MQTT cloud sync path. The ESP32-S3 radio is
            2.4 GHz ONLY - a 5 GHz-only SSID will never associate.

            Leave this empty to run the firmware fully offline. That is the
            recommended configuration for demos and for judging, because it
            removes an entire class of failure from the critical path.

            These values land in sdkconfig, which is gitignored. You may also
            put them in firmware/shrikefi/wifi_credentials.h instead (also
            gitignored), which takes precedence over this option.

    config SHRIKEFI_WIFI_PASS
        string "WiFi password"
        default ""
        depends on SHRIKEFI_WIFI_SSID != ""
        help
            WPA2 passphrase for the SSID above. Stored in sdkconfig (gitignored).
            Never commit this value to the repository.

    config SHRIKEFI_SOS_CANCEL_GPIO
        int "GPIO pin for SOS hardware cancel (Default -1 to disable, BOOT is 0)"
        default -1
        help
            Physical button to cancel an active SOS emergency without needing a
            phone connection. If set to 0, uses the ESP32-S3 BOOT button.
            Debounce is 30ms, hold time is 5s.

endmenu
```
