/*
 * ssd1306.c — SSD1306 OLED Display Driver Implementation
 * SIH26181: AI-Powered Personal Health Companion (Qualcomm)
 *
 * 128×64 pixel framebuffer-based driver with embedded 5×7 ASCII font.
 */

#include "ssd1306.h"

/* Built-in 5x7 ASCII Font (characters 0x20 - 0x7F)
 * Each character is 5 bytes wide, each byte is one column (LSB = top) */
static const uint8_t font_5x7[][5] = {
    {0x00,0x00,0x00,0x00,0x00}, /* ' '  0x20 */
    {0x00,0x00,0x5F,0x00,0x00}, /* '!'  0x21 */
    {0x00,0x07,0x00,0x07,0x00}, /* '"'  0x22 */
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    {0x10,0x08,0x08,0x10,0x08}, /* '~'  0x7E */
};

/* Internal helpers */

static int ssd1306_send_cmd(ssd1306_t *disp, uint8_t cmd) {
    uint8_t buf[2] = {SSD1306_CMD_SINGLE, cmd};
    return i2c_write(disp->i2c, SSD1306_I2C_ADDR, buf, 2);
}

static int ssd1306_send_cmd2(ssd1306_t *disp, uint8_t cmd, uint8_t arg) {
    /* Send cmd then arg as two separate single-byte commands */
    if (ssd1306_send_cmd(disp, cmd) != 0) return -1;
    return ssd1306_send_cmd(disp, arg);
}

/* Initialization */

int ssd1306_init(ssd1306_t *disp, i2c_handle_t *i2c) {
    if (!disp || !i2c) return -1;

    disp->i2c = i2c;
    disp->initialized = 0;

    /* Init sequence for 128×64 SSD1306 */
    const uint8_t init_cmds[] = {
        SSD1306_DISPLAY_OFF,
        SSD1306_SET_CLOCK_DIV, 0x80,        /* Default clock ratio    */
        SSD1306_SET_MUX_RATIO, 0x3F,        /* 64 multiplex           */
        SSD1306_SET_DISPLAY_OFFSET, 0x00,   /* No offset              */
        SSD1306_SET_START_LINE | 0x00,       /* Start line 0           */
        SSD1306_CHARGE_PUMP_SETTING,
        SSD1306_CHARGE_PUMP_ENABLE,          /* Internal charge pump   */
        SSD1306_SET_MEM_ADDR_MODE,
        SSD1306_HORIZONTAL_MODE,             /* Horizontal addressing  */
        SSD1306_SET_SEG_REMAP,               /* Column 127 = SEG0      */
        SSD1306_SET_COM_SCAN_DIR,            /* Scan COM63 → COM0      */
        SSD1306_SET_COM_PINS, 0x12,         /* Alt COM pin config     */
        SSD1306_SET_CONTRAST, 0xCF,         /* Medium-high contrast   */
        SSD1306_SET_PRECHARGE, 0xF1,        /* Phase 1=15, Phase 2=1  */
        SSD1306_SET_VCOM_DESELECT, 0x40,    /* VCOMH deselect level   */
        SSD1306_DISPLAY_ALL_ON_RES,          /* Display from RAM       */
        SSD1306_NORMAL_DISPLAY,              /* Non-inverted display   */
        SSD1306_DEACTIVATE_SCROLL,           /* No scrolling           */
        SSD1306_DISPLAY_ON                   /* Display ON             */
    };

    for (int i = 0; i < (int)(sizeof(init_cmds) / sizeof(init_cmds[0])); i++) {
        if (ssd1306_send_cmd(disp, init_cmds[i]) != 0) return -1;
    }

    /* Clear framebuffer and display */
    ssd1306_clear(disp);
    if (ssd1306_update(disp) != 0) return -1;

    disp->initialized = 1;
    return 0;
}

/* Drawing Primitives */

void ssd1306_clear(ssd1306_t *disp) {
    if (!disp) return;
    for (int i = 0; i < SSD1306_WIDTH * SSD1306_PAGES; i++) {
        disp->framebuf[i] = 0x00;
    }
}

int ssd1306_update(ssd1306_t *disp) {
    if (!disp || !disp->i2c) return -1;

    /* Set column address range: 0–127 */
    ssd1306_send_cmd(disp, SSD1306_SET_COL_ADDR);
    ssd1306_send_cmd(disp, 0x00);
    ssd1306_send_cmd(disp, 0x7F);

    /* Set page address range: 0–7 */
    ssd1306_send_cmd(disp, SSD1306_SET_PAGE_ADDR);
    ssd1306_send_cmd(disp, 0x00);
    ssd1306_send_cmd(disp, 0x07);

    /* Send framebuffer in chunks (I2C has limited buffer sizes) */
    int total = SSD1306_WIDTH * SSD1306_PAGES;  /* 1024 bytes */
    int chunk_size = 16;  /* Safe for most I2C implementations */

    for (int offset = 0; offset < total; offset += chunk_size) {
        uint8_t buf[17];  /* 1 control byte + 16 data bytes */
        buf[0] = SSD1306_DATA_STREAM;
        int remaining = total - offset;
        int len = (remaining < chunk_size) ? remaining : chunk_size;
        for (int j = 0; j < len; j++) {
            buf[j + 1] = disp->framebuf[offset + j];
        }
        if (i2c_write(disp->i2c, SSD1306_I2C_ADDR, buf, (size_t)(len + 1)) != 0) {
            return -1;
        }
    }
    return 0;
}

void ssd1306_set_pixel(ssd1306_t *disp, int x, int y, int on) {
    if (!disp || x < 0 || x >= SSD1306_WIDTH || y < 0 || y >= SSD1306_HEIGHT)
        return;

    int page = y / 8;
    int bit  = y % 8;
    int idx  = page * SSD1306_WIDTH + x;

    if (on)
        disp->framebuf[idx] |= (1 << bit);
    else
        disp->framebuf[idx] &= ~(1 << bit);
}

void ssd1306_draw_char(ssd1306_t *disp, int x, int y, char ch) {
    if (!disp) return;
    if (ch < 0x20 || ch > 0x7E) ch = ' ';

    int font_idx = ch - 0x20;
    for (int col = 0; col < 5; col++) {
        uint8_t line = font_5x7[font_idx][col];
        for (int row = 0; row < 7; row++) {
            ssd1306_set_pixel(disp, x + col, y + row, (line >> row) & 1);
        }
    }
    /* 1 pixel space between characters */
    for (int row = 0; row < 7; row++) {
        ssd1306_set_pixel(disp, x + 5, y + row, 0);
    }
}

void ssd1306_draw_string(ssd1306_t *disp, int x, int y, const char *str) {
    if (!disp || !str) return;
    int cursor_x = x;
    while (*str) {
        if (cursor_x + 6 > SSD1306_WIDTH) break;  /* Don't draw past edge */
        ssd1306_draw_char(disp, cursor_x, y, *str);
        cursor_x += 6;
        str++;
    }
}

void ssd1306_draw_char_large(ssd1306_t *disp, int x, int y, char ch) {
    if (!disp) return;
    if (ch < 0x20 || ch > 0x7E) ch = ' ';

    int font_idx = ch - 0x20;
    for (int col = 0; col < 5; col++) {
        uint8_t line = font_5x7[font_idx][col];
        for (int row = 0; row < 7; row++) {
            int on = (line >> row) & 1;
            /* 2x scale: each pixel becomes a 2×2 block */
            ssd1306_set_pixel(disp, x + col*2,     y + row*2,     on);
            ssd1306_set_pixel(disp, x + col*2 + 1, y + row*2,     on);
            ssd1306_set_pixel(disp, x + col*2,     y + row*2 + 1, on);
            ssd1306_set_pixel(disp, x + col*2 + 1, y + row*2 + 1, on);
        }
    }
}

void ssd1306_draw_string_large(ssd1306_t *disp, int x, int y, const char *str) {
    if (!disp || !str) return;
    int cursor_x = x;
    while (*str) {
        if (cursor_x + 12 > SSD1306_WIDTH) break;
        ssd1306_draw_char_large(disp, cursor_x, y, *str);
        cursor_x += 12;
        str++;
    }
}

void ssd1306_draw_hline(ssd1306_t *disp, int x, int y, int width) {
    for (int i = 0; i < width; i++) {
        ssd1306_set_pixel(disp, x + i, y, 1);
    }
}

void ssd1306_fill_rect(ssd1306_t *disp, int x, int y, int w, int h, int on) {
    for (int row = 0; row < h; row++) {
        for (int col = 0; col < w; col++) {
            ssd1306_set_pixel(disp, x + col, y + row, on);
        }
    }
}

int ssd1306_set_contrast(ssd1306_t *disp, uint8_t contrast) {
    if (!disp) return -1;
    return ssd1306_send_cmd2(disp, SSD1306_SET_CONTRAST, contrast);
}

int ssd1306_display_on(ssd1306_t *disp, int on) {
    if (!disp) return -1;
    return ssd1306_send_cmd(disp, on ? SSD1306_DISPLAY_ON : SSD1306_DISPLAY_OFF);
}
